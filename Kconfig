## Kconfig
```kconfig
# Copyright (c) 2026 jpttm
# SPDX-License-Identifier: MIT

config ZMK_GESTURE_ACTION
    bool "Enable runtime-configurable gesture actions"
    default y
    depends on DT_HAS_JPTTM_ZMK_BEHAVIOR_GESTURE_ACTION_ENABLED
    depends on SETTINGS
    select ZMK_BEHAVIOR_LOCAL_IDS
    help
      Provides &gesture_action <slot>, a behaviour whose target binding is
      stored in settings and can be changed at runtime. Intended for mouse
      gestures, which would otherwise have to consume runtime macro slots that
      users need for ordinary macros.

      Enabled automatically once a gesture-action node exists in the
      devicetree, so including behaviors/gesture_action.dtsi is all that is
      needed. Without that, the node would compile in with no driver behind it
      and every gesture would silently do nothing.

if ZMK_GESTURE_ACTION

config ZMK_GESTURE_ACTION_STUDIO_RPC
    bool "Expose gesture actions over the custom Studio RPC protocol"
    default y
    depends on ZMK_STUDIO
    help
      Lets a web UI read and reassign gesture actions over USB or Bluetooth.
      Without this the behaviour still works, but every slot is fixed to its
      devicetree default.

config ZMK_GESTURE_ACTION_LAYER_GROUPS
    bool "Expose mouse-gesture layer groups over RPC"
    default y
    depends on ZMK_GESTURE_ACTION_STUDIO_RPC
    depends on ZMK_MOUSE_GESTURE
    help
      Lets the settings UI read and change which layers each mouse-gesture
      processor acts on, so a whole gesture set can be moved from one layer to
      another without a rebuild. Needs kot149/zmk-mouse-gesture with
      active-layers support.

config ZMK_GESTURE_ACTION_COUNT
    int "Number of gesture action slots"
    default 24
    range 1 64
    help
      How many independently assignable actions exist. Each slot costs a
      handful of bytes of RAM and one settings entry, so this can be generous
      compared to runtime macro slots.

      Keep it modest anyway: the slot list is offered as one pickable entry per
      slot, and a Studio UI has to fit them all on screen. DYA Studio's
      key-assignment dialog stops short of about 28 entries with no way to
      scroll to the rest, which strands the tail of a long list.

endif
```

## dts/bindings/behaviors/jpttm,zmk-behavior-gesture-action.yaml
```yaml
# Copyright (c) 2026 jpttm
# SPDX-License-Identifier: MIT

description: |
  Behaviour whose target binding is held in settings and can be reassigned at
  runtime. Takes a slot number as its parameter.

  Slots with no stored value fall back to the entry at the same index in
  default-bindings, so a freshly flashed board behaves usefully before it is
  ever configured.

compatible: "jpttm,zmk-behavior-gesture-action"

include: one_param.yaml

properties:
  default-bindings:
    type: phandle-array
    # Without this, devicetree derives "#default-binding-cells" from the
    # property name and rejects every behaviour, which only declares
    # "#binding-cells".
    specifier-space: binding
    description: |
      Compile-time fallback for each slot, in slot order. Entry 0 is the
      fallback for slot 0, and so on. May be shorter than
      ZMK_GESTURE_ACTION_COUNT; slots past the end simply do nothing until
      assigned.

  slot-names:
    type: string-array
    description: |
      Label for each slot, in slot order, shown by configuration UIs in place of
      a bare number. Keep them short - they are carried over RPC with a 24-byte
      cap. May be shorter than the slot count; unnamed slots fall back to their
      number.

  reserved-layers:
    type: array
    description: |
      Layers this keyboard wants kept for ordinary use, which a configuration
      UI should therefore not offer as a target for gestures. Give the layer
      numbers, not a bitmask.

      A layer with gestures on it loses ordinary cursor movement, so a board
      whose base and pointing layers are fixed by design should say so here
      rather than leave a user to find out.

      This is for policy only, and it is the whole of what you need to write.
      Layers that *cannot* work are found automatically: every input listener
      in the tree is walked, and any layer claimed by an override that does not
      set process-next is reserved too, because an override returns before the
      base chain a gesture processor sits in. That means moving a scroll layer
      needs no edit here.

      Omit it and no layer is reserved on policy grounds.

  display-name:
    type: string
```
